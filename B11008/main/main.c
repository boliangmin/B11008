/************************************************************************************************************************************************
* 文件名称：main.c
* 文件描述：主函数
* 文件作者：bo.liangmin
* 版本信息：20240406--文件创建
************************************************************************************************************************************************/



/************************************************************************************************************************************************
* include
************************************************************************************************************************************************/
#include <stdio.h>
#include <stdbool.h>
#include <unistd.h>
#include <freertos/FreeRTOS.h>
#include <freertos/task.h>

#include "hal_ws2812.h"
#include "framework_hardware.h"
#include "framework_aht10.h"


#include "esp_log.h"


/************************************************************************************************************************************************
* define
************************************************************************************************************************************************/
static const char *MAINTAG = "WS2812";




/************************************************************************************************************************************************
* 函数名称：static void led_flash_task(void *arg)
* 函数说明：LED闪烁任务
* 输入参数：无
* 输出参数：无
* 返回数值：无
************************************************************************************************************************************************/
static void led_flash_task(void *arg)
{
    static uint8_t dddd = 0;
    ws2812_color_t color = {0, 0, 0};

    while (1)
    {
//        FrameWork_AHT10_ReadData();
        ESP_LOGI(MAINTAG, "task run");

        if(0 == dddd)
        {
            color.red   = 255;
            color.green = 0;
            color.blue  = 0;

            HAL_WS2812_SetShowNum(HAL_WS2812_RIGHT2_ADDR, 1);
            HAL_WS2812_SetShowNum(HAL_WS2812_RIGHT1_ADDR, 2);
            HAL_WS2812_SetShowType(TYPE_DATE);
            HAL_WS2812_SetShowNum(HAL_WS2812_LEFT2_ADDR, 3);
            HAL_WS2812_SetShowNum(HAL_WS2812_LEFT1_ADDR, 4);

            HAL_WS2812_ClkFresh(color);

            dddd = 1;
        }
        else
        {
            color.red   = 0;
            color.green = 255;
            color.blue  = 0;

            HAL_WS2812_SetShowNum(HAL_WS2812_RIGHT2_ADDR, 5);
            HAL_WS2812_SetShowNum(HAL_WS2812_RIGHT1_ADDR, 6);
            HAL_WS2812_SetShowType(TYPE_TIME);
            HAL_WS2812_SetShowNum(HAL_WS2812_LEFT2_ADDR, 7);
            HAL_WS2812_SetShowNum(HAL_WS2812_LEFT1_ADDR, 8);

            HAL_WS2812_ClkFresh(color);

            dddd = 0;
        }



        vTaskDelay(1000);
    }
}

/************************************************************************************************************************************************
* 函数名称：void app_main(void)
* 函数说明：main函数
* 输入参数：无
* 输出参数：无
* 返回数值：无
************************************************************************************************************************************************/
void app_main(void)
{


//    FrameWork_Hardware_Init();
//    FrameWork_AHT10_DeviceInit();
    HAL_WS2812_Init();


    xTaskCreatePinnedToCore(led_flash_task, "led task", 8192, NULL, 2, NULL, tskNO_AFFINITY);

    while(1)
    {
        vTaskDelay(1000);
    }
}



/************************************************************************************************************************************************
* end
************************************************************************************************************************************************/


